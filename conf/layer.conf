## conf/layer.conf
```bitbake
# We have a conf and classes directory, add to BBPATH
BBPATH .= ":${LAYERDIR}"

# We have recipes-* directories, add to BBFILES
BBFILES += "${LAYERDIR}/recipes-*/*/*.bb \
            ${LAYERDIR}/recipes-*/*/*.bbappend"

BBFILE_COLLECTIONS += "rmduarte"
BBFILE_PATTERN_rmduarte = "^${LAYERDIR}/"
BBFILE_PRIORITY_rmduarte = "6"

LAYERDEPENDS_rmduarte = "core"
LAYERSERIES_COMPAT_rmduarte = "honister"
```

## conf/machine/rasp4mod.conf
```bitbake
#@Type: Machine
#@Name: rasp4mod
#@Description: Machine configuration file based on Rapi4 model B
MACHINEOVERRIDES .=":raspberrypi4"

require conf/machine/raspberrypi4.conf

#Setting bootloader configuration
RPI_USE_U_BOOT = "1"

ENABLE_I2C = "1"
KERNEL_MODULE_AUTOLOAD:rpi += "i2c-dev i2c-bcm2835"

ENABLE_UART = "1"

HDMI_GROUP = "2"
HDMI_MODE = "86"
```
